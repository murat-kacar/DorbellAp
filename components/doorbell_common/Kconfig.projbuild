## components/doorbell_common/Kconfig.projbuild
```kconfig
# Settings shared by both firmwares. Role settings: firmware/<role>/main/Kconfig.projbuild
menu "Doorbell System Configuration"

    menu "Doorbell network"

        config DOORBELL_UDP_PORT
            int "UDP port"
            range 1024 49151
            default 19500
            help
                UDP port used by the entrance panel and apartment modules (default 19500, in the IANA User Port
                range and below the lwIP ephemeral port range 49152-65535).

        config DOORBELL_WIFI_SET_COUNTRY
            bool "Set a Wi-Fi country code"
            default n
            help
                Enable to apply an explicit two-letter ISO country code (e.g. "TR") so channels 12-13 can be scanned
                actively. When disabled, ESP-IDF uses default "01" world safe mode (channels 1-11 active, 12-13
                passive).

        config DOORBELL_WIFI_COUNTRY_CODE
            string "Country code"
            depends on DOORBELL_WIFI_SET_COUNTRY
            default "TR"
            help
                Two-letter country code (e.g., "TR" for channels 1-13).

        config DOORBELL_WIFI_STA_11B_ONLY
            bool "Restrict the station interface to 802.11b"
            default y
            help
                Calls esp_wifi_set_protocol(WIFI_IF_STA, WIFI_PROTOCOL_11B) so the station only uses the 802.11b
                DSSS/CCK rates (1, 2, 5.5, 11 Mbps), which need a lower SNR than OFDM/HT rates and can extend the
                usable link distance. Enabled by default for long-range operation; disable to return to the
                ESP-IDF default (802.11b/g/n).
                The building AP must still accept 802.11b clients: an AP with "disable 802.11b" or a minimum basic
                rate above 11 Mbps will refuse association.

        config DOORBELL_ACK_TIMEOUT_MS
            int "Application ACK timeout (ms)"
            range 100 5000
            default 400
            help
                Milliseconds to wait for an application-layer ACK on each attempt (+/- 25 ms jitter on retries).

        config DOORBELL_PAIRING_COMPLETE_TIMEOUT_S
            int "Pairing completion timeout (s)"
            range 6 60
            default 10
            help
                Additional seconds allowed after SoftAP provisioning for the apartment module to join the building AP,
                obtain a DHCP lease, and send authenticated PAIR_COMPLETE over the LAN.
                Must be at least 5 s (LAN join) + 4 x ACK timeout + 0.5 s; checked at compile time.

        config DOORBELL_NVS_COUNTER_BLOCK
            int "Replay counter NVS block size"
            range 10 10000
            default 100
            help
                Write-ahead reservation block size for the monotonic AES-CCM transmit frame counter in NVS (RFC 8613).

        config DOORBELL_HEARTBEAT_ENABLED
            bool "Module health reports (heartbeat)"
            default y
            help
                When enabled, each paired apartment module sends confirmable periodic health reports to the panel.

        config DOORBELL_HEARTBEAT_INTERVAL_S
            int "Heartbeat interval (s)"
            depends on DOORBELL_HEARTBEAT_ENABLED
            range 30 3600
            default 300
            help
                Interval in seconds between confirmable heartbeat reports (+/- 10% jitter). Provisioned to modules
                during pairing.

    endmenu

    menu "Doorbell status LED"

        config DOORBELL_LED_ACTIVE_HIGH
            bool "LED is on when the GPIO is HIGH"
            default y

        config DOORBELL_LED_FULL_BRIGHTNESS_PCT
            int "Full brightness (%)"
            range 10 100
            default 100

        config DOORBELL_LED_DIM_BRIGHTNESS_PCT
            int "Dim brightness (%)"
            range 1 50
            default 10

        config DOORBELL_LED_SHORT_FLASH_MS
            int "Short flash duration (ms)"
            range 10 500
            default 50

        config DOORBELL_LED_FAST_PERIOD_MS
            int "Fast blink period (ms)"
            range 40 1000
            default 200

        config DOORBELL_LED_MEDIUM_PERIOD_MS
            int "Medium blink period (ms)"
            range 100 2000
            default 500

        config DOORBELL_LED_SLOW_PERIOD_MS
            int "Slow blink period (ms)"
            range 200 4000
            default 1000

        config DOORBELL_LED_MULTI_PULSE_MS
            int "Double/triple flash pulse (ms)"
            range 20 500
            default 100

        config DOORBELL_LED_MULTI_GAP_MS
            int "Double/triple flash inter-pulse gap (ms)"
            range 20 500
            default 100

        config DOORBELL_LED_MULTI_PERIOD_MS
            int "Double/triple flash repeat period (ms)"
            range 500 5000
            default 1000

        config DOORBELL_LED_SPARSE_PERIOD_MS
            int "Sparse flash repeat period (ms)"
            range 1000 10000
            default 3000

        config DOORBELL_LED_OK_DURATION_MS
            int "Success indication duration (ms)"
            range 200 10000
            default 2000

        config DOORBELL_LED_ERR_DURATION_MS
            int "Error indication duration (ms)"
            range 200 10000
            default 1000

        config DOORBELL_LED_NO_RESP_DURATION_MS
            int "No-response indication duration (ms)"
            range 500 10000
            default 3000

    endmenu

endmenu
```

## firmware/panel/main/Kconfig.projbuild
```kconfig
# Entrance panel settings. Shared settings (network, heartbeat, status LED) are in
# components/doorbell_common/Kconfig.projbuild; the flasher builds its form from both files.
menu "Doorbell panel"

    menu "Setup portal"

        config DOORBELL_PANEL_PORTAL_TIMEOUT_S
            int "Wi-Fi setup portal timeout (s)"
            range 30 600
            default 120
            help
                Duration in seconds that the Doorbell-Setup WPA3-SAE SoftAP remains open.

    endmenu

    menu "GPIO (Classic ESP32)"

        config DOORBELL_PANEL_GPIO_ROW0
            int "Keypad row 0 GPIO"
            range 0 33
            default 13
        config DOORBELL_PANEL_GPIO_ROW1
            int "Keypad row 1 GPIO"
            range 0 33
            default 14
        config DOORBELL_PANEL_GPIO_ROW2
            int "Keypad row 2 GPIO"
            range 0 33
            default 27
        config DOORBELL_PANEL_GPIO_ROW3
            int "Keypad row 3 GPIO"
            range 0 33
            default 26
        config DOORBELL_PANEL_GPIO_COL0
            int "Keypad column 0 GPIO"
            range 0 39
            default 25
        config DOORBELL_PANEL_GPIO_COL1
            int "Keypad column 1 GPIO"
            range 0 39
            default 33
        config DOORBELL_PANEL_GPIO_COL2
            int "Keypad column 2 GPIO"
            range 0 39
            default 32
        config DOORBELL_PANEL_GPIO_DOOR_RELAY
            int "Door relay GPIO"
            range 0 33
            default 23
        config DOORBELL_PANEL_DOOR_RELAY_ACTIVE_LOW
            bool "Door relay is driven LOW to open"
            default y
        config DOORBELL_PANEL_GPIO_STATUS_LED
            int "Status LED GPIO"
            range 0 33
            default 2
        config DOORBELL_PANEL_GPIO_RESET_BTN
            int "Hidden factory reset button GPIO"
            range 0 39
            default 19
        config DOORBELL_PANEL_RESET_BTN_ACTIVE_LOW
            bool "Factory reset button pulls the GPIO LOW"
            default y
        config DOORBELL_PANEL_RESET_BTN_INTERNAL_PULL
            bool "Enable the internal pull resistor"
            default y

    endmenu

    menu "Keypad"

        config DOORBELL_PANEL_KEY_MAP
            string "Key map (12 characters, row-major)"
            default "123456789*0#"
            help
                12-character row-major mapping for the 4x3 keypad matrix.

        config DOORBELL_PANEL_INPUT_TIMEOUT_S
            int "Input timeout (s)"
            range 3 60
            default 10
            help
                Seconds of inactivity before an incomplete keypad sequence is cleared.

    endmenu

    menu "Door relay"

        config DOORBELL_PANEL_DOOR_PULSE_MS
            int "Door relay pulse (ms)"
            range 100 10000
            default 500
            help
                Milliseconds the door lock relay remains energized on door open.

    endmenu

    menu "Apartments and codes"

        config DOORBELL_PANEL_MIN_APT_NO
            int "Lowest apartment number"
            range 1 99
            default 1

        config DOORBELL_PANEL_MAX_APT_NO
            int "Highest apartment number"
            range 1 99
            default 99

        config DOORBELL_PANEL_ADMIN_CODE_LEN
            int "Admin code length"
            range 8 10
            default 8
            help
                Number of digits in the panel administrator code (minimum 8 digits required for WPA3-SAE setup AP).

        config DOORBELL_PANEL_USER_CODE_LEN
            int "User code length"
            range 4 8
            default 4
            help
                Number of digits in the shared building door-open code.

    endmenu

    menu "Keypad lockout"

        config DOORBELL_PANEL_LOCKOUT_WRONG_CODES
            int "Wrong codes before lockout"
            range 1 20
            default 5

        config DOORBELL_PANEL_LOCKOUT_FIRST_S
            int "First lockout (s)"
            range 10 3600
            default 60

        config DOORBELL_PANEL_LOCKOUT_MULTIPLIER
            int "Lockout multiplier"
            range 1 10
            default 2

        config DOORBELL_PANEL_LOCKOUT_MAX_S
            int "Maximum lockout (s)"
            range 10 86400
            default 900

    endmenu

    menu "Factory reset button"

        config DOORBELL_PANEL_RESET_MIN_HOLD_S
            int "Minimum hold (s)"
            range 3 30
            default 10

        config DOORBELL_PANEL_RESET_MAX_HOLD_S
            int "Maximum hold (s)"
            range 15 65
            default 60

    endmenu

    menu "Other"

        config DOORBELL_PAIRING_WINDOW_S
            int "Pairing window (s)"
            range 10 120
            default 20
            help
                Duration in seconds of the panel's temporary SoftAP module discovery window.

        config DOORBELL_PANEL_RING_RETRIES
            int "RING retries without ACK"
            range 0 5
            default 2

        config DOORBELL_PANEL_SILENCE_RESTART
            bool "Restart the panel when no module reports"
            depends on DOORBELL_HEARTBEAT_ENABLED
            default y
            help
                When at least one apartment is registered and no module sends a heartbeat for 3 consecutive
                intervals, restart the panel with persistent RTC backoff (15 min -> 48 h).

    endmenu

endmenu
```

## firmware/unit/main/Kconfig.projbuild
```kconfig
# Apartment module settings. Shared settings (network, heartbeat, status LED) are in
# components/doorbell_common/Kconfig.projbuild; the flasher builds its form from both files.
menu "Doorbell apartment module"

    menu "GPIO (Classic ESP32)"

        config DOORBELL_UNIT_GPIO_BELL_RELAY
            int "Bell relay GPIO"
            range 0 33
            default 4
        config DOORBELL_UNIT_BELL_RELAY_ACTIVE_HIGH
            bool "Bell relay is driven HIGH to ring"
            default y
        config DOORBELL_UNIT_GPIO_DOOR_BTN
            int "Door-open button GPIO"
            range 0 39
            default 23
        config DOORBELL_UNIT_GPIO_PAIR_BTN
            int "Hidden pairing button GPIO"
            range 0 39
            default 18
        config DOORBELL_UNIT_GPIO_RESET_BTN
            int "Hidden reset button GPIO"
            range 0 39
            default 19
        config DOORBELL_UNIT_BTNS_ACTIVE_LOW
            bool "Buttons pull the GPIO LOW when pressed"
            default y
        config DOORBELL_UNIT_BTNS_INTERNAL_PULL
            bool "Enable the internal pull resistors"
            default y
        config DOORBELL_UNIT_GPIO_STATUS_LED
            int "Status LED GPIO"
            range 0 33
            default 2

    endmenu

    menu "Bell"

        config DOORBELL_UNIT_BELL_PULSE_MS
            int "Bell relay pulse (ms)"
            range 100 10000
            default 500

        config DOORBELL_UNIT_VISUAL_BELL
            bool "Blink the status LED while ringing"
            default y

    endmenu

    menu "Buttons"

        config DOORBELL_UNIT_DOOR_BTN_MIN_MS
            int "Door button minimum press (ms)"
            range 20 2000
            default 100

        config DOORBELL_UNIT_DOOR_BTN_MAX_S
            int "Door button maximum press (s)"
            range 5 120
            default 30

        config DOORBELL_UNIT_HOLD_BTN_MIN_S
            int "Pairing/reset button minimum hold (s)"
            range 3 20
            default 7

        config DOORBELL_UNIT_HOLD_BTN_MAX_S
            int "Pairing/reset button maximum hold (s)"
            range 5 30
            default 12

        config DOORBELL_UNIT_HOLD_BTN_CANCEL_S
            int "Pairing/reset button cancel after (s)"
            range 8 65
            default 15

    endmenu

    menu "Other"

        config DOORBELL_HEARTBEAT_RETRIES
            int "HEARTBEAT retries without ACK"
            depends on DOORBELL_HEARTBEAT_ENABLED
            range 0 5
            default 1
            help
                Number of retransmission attempts for HEARTBEAT_REQ when no HEARTBEAT_ACK arrives.

        config DOORBELL_UNIT_OPEN_DOOR_RETRIES
            int "OPEN_DOOR retries without ACK"
            range 0 5
            default 1

    endmenu

endmenu
```
